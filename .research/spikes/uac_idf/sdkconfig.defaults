## .research/spikes/uac_idf/sdkconfig.defaults
```kconfig
CONFIG_IDF_TARGET="esp32s3"
CONFIG_ESP_DEFAULT_CPU_FREQ_MHZ_240=y
CONFIG_FREERTOS_HZ=1000
CONFIG_AUTOSTART_ARDUINO=n
# Prefer -O2 for UI convert/compose on T-Embed; size builds stay under budget.
CONFIG_COMPILER_OPTIMIZATION_PERF=y
CONFIG_UAC_MIC_CHANNEL_NUM=1
CONFIG_UAC_SPEAKER_CHANNEL_NUM=0
CONFIG_UAC_SAMPLE_RATE=48000
CONFIG_UAC_BYTES_PER_SAMPLE=2
CONFIG_UAC_MIC_INTERVAL_MS=1
CONFIG_UAC_SUPPORT_MACOS=y
CONFIG_USB_DEVICE_UAC_AS_PART=y
CONFIG_UAC_MIC_TASK_PRIORITY=5
CONFIG_UAC_MIC_TASK_CORE=1
CONFIG_CADENZA_T_EMBED_MICROPHONE=n
CONFIG_CODEC_ES7210_SUPPORT=y
CONFIG_CODEC_I2C_BACKWARD_COMPATIBLE=n
CONFIG_CODEC_ES8311_SUPPORT=n
CONFIG_CODEC_ES7243_SUPPORT=n
CONFIG_CODEC_ES7243E_SUPPORT=n
CONFIG_CODEC_ES8156_SUPPORT=n
CONFIG_CODEC_AW88298_SUPPORT=n
CONFIG_CODEC_ES8389_SUPPORT=n
CONFIG_CODEC_ES8374_SUPPORT=n
CONFIG_CODEC_ES8388_SUPPORT=n
CONFIG_CODEC_TAS5805M_SUPPORT=n
CONFIG_CODEC_ZL38063_SUPPORT=n
CONFIG_CODEC_CJC8910_SUPPORT=n
CONFIG_CODEC_DUMMY_SUPPORT=n
CONFIG_CODEC_DATA_ADC_SUPPORT=n
```

## .research/spikes/uac_idf/src/Kconfig.projbuild
```kconfig
menu "Cadenza candidate hardware"

config CADENZA_T_EMBED_RUNTIME
    bool "Build the complete T-Embed display/input/App runtime"
    default n
    help
        Link the portable runtime and bundled Apps with the ESP-IDF esp_lcd
        ST7789 and GPIO encoder adapters. The hardware candidate enables this
        together with speaker, microphone and USB Audio.

config CADENZA_T_EMBED_MICROPHONE
    bool "Use the physical T-Embed ES7210 microphone instead of synthetic PCM"
    default n
    help
        Build and execute the researched ES7210/I2S1 adapter. Leave disabled
        when no physical original T-Embed is connected. The adapter source is
        compiled in either mode so CI still checks the SDK integration.

config CADENZA_T_EMBED_SPEAKER
    bool "Use the physical T-Embed MAX98357A speaker output"
    default n
    help
        Build and execute the ESP-IDF 5 I2S0 output adapter. It owns a task,
        DMA channel and buffers independent from the I2S1 microphone adapter.

config CADENZA_CONNECTIVITY_RUNTIME
    bool "Build ESP-IDF Wi-Fi, NimBLE and Security 2 adapter"
    depends on CADENZA_T_EMBED_RUNTIME
    default y
    help
        Connect the portable capability/lease-driven connectivity service to
        ESP-IDF Wi-Fi/IP events, NimBLE GAP roles and the official BLE Wi-Fi
        provisioning manager. Security 0 is not supported by this adapter;
        Security 2 material must come from the privileged platform hook.

endmenu
```

## hardware/cadenza/validation/l1-display-firmware/sdkconfig.defaults
```kconfig
CONFIG_COMPILER_OPTIMIZATION_PERF=y
CONFIG_ESPTOOLPY_FLASHSIZE_16MB=y
CONFIG_ESPTOOLPY_FLASHMODE_DIO=y
CONFIG_ESPTOOLPY_MONITOR_BAUD=115200
CONFIG_LOG_DEFAULT_LEVEL_INFO=y
# This offline GPIO/SPI test has no TLS use. Avoid the certificate-bundle
# generator and its unrelated host-Python dependency.
CONFIG_MBEDTLS_CERTIFICATE_BUNDLE=n
```

## hardware/cadenza/validation/l2-input-firmware/main/Kconfig.projbuild
```kconfig
menu "Cadenza L2 input validation"

config L2_ENCODER_COUNTS_PER_DETENT
    int "Valid Gray-code transitions per detent"
    range 1 4
    default 4
    help
        This is deliberately configurable because the purchased EC12 has not
        yet been measured. It can also be changed with the serial `cpd` command.

config L2_ENCODER_REVERSE
    bool "Reverse reported encoder direction"
    default n
    help
        Changes only the reported direction. It does not assume which physical
        EC12 terminal is A or B. It can also be changed with `reverse`.

config L2_BUTTON_DEBOUNCE_MS
    int "Button stable time (ms)"
    range 1 100
    default 20

config L2_BUTTON_LONG_PRESS_MS
    int "Long-press threshold (ms)"
    range 100 5000
    default 800

config L2_STATUS_PERIOD_MS
    int "Periodic status interval (ms)"
    range 100 10000
    default 1000

config L2_EVENT_LOGGING
    bool "Print each encoder/button event"
    default n
    help
        Disabled by default because printing every detent can itself make a
        high-speed encoder test lose events. Runtime command `events 0|1`
        overrides this setting; periodic statistics are always printed.

endmenu
```

## hardware/cadenza/validation/l2-input-firmware/sdkconfig.defaults
```kconfig
CONFIG_IDF_TARGET="esp32s3"
CONFIG_COMPILER_OPTIMIZATION_PERF=y
CONFIG_FREERTOS_HZ=1000
CONFIG_ESP_CONSOLE_UART_BAUDRATE=115200
CONFIG_MBEDTLS_CERTIFICATE_BUNDLE=n

# Candidate defaults. Both encoder values can also be changed at runtime.
CONFIG_L2_ENCODER_COUNTS_PER_DETENT=4
# CONFIG_L2_ENCODER_REVERSE is not set
CONFIG_L2_BUTTON_DEBOUNCE_MS=20
CONFIG_L2_BUTTON_LONG_PRESS_MS=800
CONFIG_L2_STATUS_PERIOD_MS=1000
# CONFIG_L2_EVENT_LOGGING is not set
```
